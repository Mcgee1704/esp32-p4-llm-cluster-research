## firmware-versions/0.9.0/source/firmware/main/Kconfig.projbuild
```kconfig
menu "P4 TinyStories LAN"
config CLUSTER_KEY
    string "Shared LAN access key (at least 24 characters)"
    default ""
    help
        Same key on both boards. Empty key disables inference and uploads.
        Provision once at local build time; never publish this value.
config CLUSTER_PHY_ADDR
    int "IP101 PHY address (-1 auto-detect)"
    range -1 31
    default -1
endmenu
```

## firmware-versions/0.9.0/source/firmware/sdkconfig.defaults
```kconfig
CONFIG_IDF_TARGET="esp32p4"
CONFIG_ESPTOOLPY_FLASHSIZE_32MB=y
CONFIG_ESPTOOLPY_FLASHMODE_QIO=y
CONFIG_PARTITION_TABLE_CUSTOM=y
CONFIG_PARTITION_TABLE_CUSTOM_FILENAME="partitions.csv"
CONFIG_BOOTLOADER_APP_ROLLBACK_ENABLE=y
CONFIG_BOOTLOADER_LOG_LEVEL_WARN=y
CONFIG_COMPILER_OPTIMIZATION_PERF=y
CONFIG_SPIRAM=y
CONFIG_SPIRAM_SPEED_200M=y
CONFIG_SPIRAM_USE_MALLOC=y
CONFIG_SPIRAM_MALLOC_ALWAYSINTERNAL=16384
CONFIG_ESP_MAIN_TASK_STACK_SIZE=12288
CONFIG_FREERTOS_HZ=1000
CONFIG_ETH_USE_ESP32_EMAC=y
CONFIG_LWIP_SO_RCVBUF=y
CONFIG_LWIP_MAX_SOCKETS=32
CONFIG_HTTPD_MAX_REQ_HDR_LEN=1024
CONFIG_HTTPD_MAX_URI_LEN=128
```
